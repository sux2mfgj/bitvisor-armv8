## Kconfig
```kconfig
mainmenu  "BitVisor $(ARCH)/ Configuration"

menu "Architecture dependents"

source "arch/$(ARCH)/Kconfig"

endmenu

menu "Drivers"

source "drivers/Kconfig"

endmenu

menu "General"

source "core/Kconfig"

endmenu

config DEBUG_GDB
    bool
    default n
    prompt "gdb remote debug support (32bit only)"

config TTY_SERIAL
    bool
    default n
    prompt "VMM uses a serial port (COM1) for output"

config TTY_X540
    bool
    default y
    prompt "VMM output to LAN"

config CPU_MMU_SPT_1
    bool
    default n
    prompt "Shadow type 1 (very slow and stable)"

config CPU_MMU_SPT_2
    bool
    default n
    prompt "Shadow type 2 (faster and unstable)"

config CPU_MMU_SPT_3
    bool
    default y
    prompt "Shadow type 3 (faster and unstable)"

config CPU_MMU_SPT_DISABLE
    bool
    default n
    prompt "Disable SPT (fast, insecure and no MMIO)"

config CPU_MMU_SPT_USE_PAE
    bool
    default y
    prompt "Shadow page table uses PAE"

config PS2KBD_F11PANIC
    bool
    default n
    prompt "Panic when F11 is pressed (PS/2 only)"

config PS2KBD_F12MSG
    bool
    default y
    prompt "Print when F12 is pressed (PS/2 only)"

config DBGSH
    bool
    default y
    prompt "Debug shell access from guest"

config STATUS
    bool
    default n
    prompt "Provide VMM status for guest"

config LOG_TO_GUEST
    bool
    default n
    prompt "Log to guest memory"

config LOG_TO_IEEE1394
    bool
    default y
    prompt "Log to IEEE 1394 host"


config STORAGE
    bool
    default y
    prompt "Enable storage process/encryption"

config STORAGE_IO
    bool
    default y
    prompt "Enable storage IO interface"

config CRYPTO
    bool
    default y
    prompt "Crypto library"

config VPN
    bool
    default y
    prompt "Enable IPsec VPN Client"


config SHADOW_UHCI
    bool
    default y
    prompt "Shadow UHCI(USB1) transfers"

config SHADOW_EHCI
    bool
    default y
    prompt "Shadow EHCI(USB2) transfers"

config SHADOW_XHCI
    bool
    default y
    prompt "Shadow xHCI(USB3) transfers"

config HANDLE_USBMSC
    bool
    default y
    prompt "Handle USB mass storage class devices"

config HANDLE_USBHUB
    bool
    default y
    prompt "Handle USB hub class devices"

config CONCEAL_USBCCID
    bool
    default y
    prompt "Conceal USB ccid class device"

config PS2KBD_F10USB
    bool
    default n
    prompt "Run a test for USB ICCD when F10 pressed"

config PS2KBD_F12USB
    bool
    default y
    prompt "Dump EHCI async. list when F12 pressed"

config IEEE1394_CONCEALER
    bool
    default y
    prompt "Conceal OHCI IEEE 1394 host controllers"

config ACPI_DSDT
    bool
    default y
    prompt "Parse ACPI DSDT"

config DISABLE_SLEEP
    bool
    default n
    prompt "Disable ACPI S2 and S3"

config ENABLE_ASSERT
    bool
    default y
    prompt "Enable checking assertion failure"

config SELECT_AES_GLADMAN
    bool
    default n
    prompt "Select Dr. Gladmans AES assembler code"

config CARDSTATUS
    bool
    default y
    prompt "Panic if an IC card is ejected (IDMAN)"

config IDMAN
    bool
    default y
    prompt "IDMAN (CRYPTO must be enabled)"

config VTD_TRANS
    bool
    default n
    prompt "Enable VT-d translation"

config STORAGE_PD
    bool
    default n
    prompt "Storage encrypting in protection domain"

config IDMAN_PD
    bool
    default n
    prompt "IDMan in protection domain"

config VPN_PD
    bool
    default n
    prompt "VPN in protection domain"

config DISABLE_TCG_BIOS
    bool
    default n
    prompt "Disable TCG BIOS (TPM related)"

config ACPI_TIME_SOURCE
    bool
    default y
    prompt "Use ACPI PM Timer as time source"

config TCG_BIOS
    bool
    default n
    prompt "TCG BIOS support"

config BACKTRACE
    bool
    default n
    prompt "Enable backtrace in panic"

config SHIFT_KEY_DEBUG
    bool
    default n
    prompt "Debug shell with shift key while booting"

config DUMP_PCI_DEV_LIST
    bool
    default n
    prompt "Dump list of PCI devices"

config NETAPI
    bool
    default y
    prompt "enable netapi"

config IP
    bool
    default y
    prompt "Enable TCP/IP stack"

config THREAD_1CPU
    bool
    prompt "Disable parallel thread processing"

config ACPI_IGNORE_ERROR
    bool
    default n
    prompt "Ignore ACPI DSDT/SSDT parse errors"

config MAP_UEFI_MMIO
    bool
    default n
    prompt "Map EfiMemoryMappedIO space"

config DISABLE_VTD
    bool
    default y
    prompt "Disable VT-d translation if enabled"

config DMAR_PASS_THROUGH
    bool
    default n
    prompt "Enable DMAR pass-through"

config USE_SYSCALL64
    bool
    default n
    prompt "Use SYSCALL for 64bit system call"

config SQLITE
    bool
    default n
    prompt "SQLite in protection domain"

config USE_BUILTIN_STRING
    bool "Use gcc builtin string"
    default y
```

## arch/aarch64/Kconfig
```kconfig
config AARCH64
    bool
    default y

menu "AArch64 Boards Support"

config AARCH64_VIRT
    bool "Qemu Aarch64 virt board support"
    default y

config AARCH64_BOARD
    string
    default virt if AARCH64_VIRT

endmenu
```

## arch/x86_64/Kconfig
```kconfig
config X86
    bool
    default y

config 64
    bool
    default y
    prompt "64bit VMM"
```

## core/Kconfig
```kconfig
config DEVICE_TREE
    bool "device tree parser"
    default n

config SKIP_UNKNOWN_DT_PROP
    bool "skip when found unknown device tree property"
    default y
    depends on DEVICE_TREE
```

## drivers/Kconfig
```kconfig
config ATA_DRIVER
    bool
    default y
    prompt "Enable ATA driver"

config NVME_DRIVER
    bool
    default y
    prompt "Enable NVMe driver"

config USB_DRIVER
    bool
    default y
    prompt "Enable USB driver"

config NET_DRIVER
    bool
    default y
    prompt "Enable NIC drivers"

config VGA_INTEL_DRIVER
    bool
    default n
    prompt "Enable vga_intel driver"

config DEBUG_ATA
    bool
    default n
    prompt "Enable debugging ATA driver"

config NET_PRO100
    bool
    default y
    prompt "Intel PRO/100 driver"

config NET_PRO1000
    bool
    default y
    prompt "Intel PRO/1000 driver"

config NET_RTL8169
    bool
    prompt "Realtek RTL8169 driver"

config NET_RE
    bool
    default n
    prompt "Realtek Family driver"

config NET_BNX
    bool
    default y
    prompt "Broadcom NetXtreme GbE driver"

config NET_AQ
    bool
    default n
    prompt "Aquantia ACQ107 driver"

config NET_VIRTIO_NET
    bool
    default y
    prompt "Enable virtio-net for PRO1000/BNX"

config NET_V_VIRTIO_NET
    bool
    default y
    prompt "Enable virtio-net virtual driver"

config VPN_VE
    bool
    default n
    prompt "Enable ve (Virtual Ethernet) driver"

config PCI_MONITOR
    bool
    default y
    prompt "PCI I/O monitor driver"

config TTY_VGA
    bool
    default n
    prompt "VMM output using VGA driver"

config UART_DRIVER
    bool "UART driver"
    default n

config UART_EARLY_PUTC
    bool "Use UART for early putc"
    default n
    depends on UART_DRIVER

config UART_EARLY_PUTC_MMIO_BASE
    hex "mmio base address"
    depends on UART_EARLY_PUTC

config ARM_GIC_V2
    bool "Arm generic interrupt controller v2"
    default n
```

## tools/kconfig/samples/Kconfig.menu
```kconfig
mainmenu  "BitVisor $(ARCH)/ Configuration"

menu "Architecture dependents"

endmenu
```
